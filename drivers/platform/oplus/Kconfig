## drivers/platform/oplus/Kconfig
```kconfig
# OPlus configuration options

config MACH_OPLUS
	bool "OPlus device"
	depends on ARCH_QCOM
	help
	  Support for OPlus products

config MACH_OPLUS_SM7150
	bool "OPlus SM7150"
	depends on ARCH_QCOM
	select MACH_OPLUS
	help
	  Support for OPlus SM7150 devices
```

## drivers/power/oplus/Kconfig
```kconfig
config OPLUS_CHARGER
	bool "OPLUS Charger Driver (SM7150R)"
	depends on MACH_OPLUS && I2C
	select REGMAP_I2C
	help
	  Say Y here to enable OPLUS charging system support

if OPLUS_CHARGER

config OPLUS_SM7150R_CHARGER
	bool "OPLUS SM7150R charger driver"
	default y
	help
	  Compatibility symbol used by the original SM7150R charging sources.

config OPLUS_CALL_MODE_SUPPORT
	bool "OPLUS call mode support"
	default y

config OPLUS_CHECK_CHARGERID_VOLT
	bool "OPLUS charger-ID voltage support"
	default y

config OPLUS_CHIP_SOC_NODE
	bool "Expose the OPLUS chip SOC property"
	default y

config OPLUS_RTC_DET_SUPPORT
	bool "OPLUS RTC reset detection"
	default y

config OPLUS_SHIP_MODE_SUPPORT
	bool "OPLUS ship mode support"
	default y

config OPLUS_SHORT_C_BATT_CHECK
	bool "OPLUS battery short-circuit protection"
	default y

config OPLUS_SHORT_HW_CHECK
	bool "OPLUS hardware battery short-circuit check"
	default y

config OPLUS_SHORT_IC_CHECK
	bool "OPLUS external short-circuit IC check"
	default y

config OPLUS_SHORT_USERSPACE
	bool "OPLUS userspace short-circuit controls"
	default y

config OPLUS_SMART_CHARGER_SUPPORT
	bool "OPLUS smart charger controls"
	default y

config OPLUS_SMOOTH_SOC
	bool "OPLUS smooth soc support"
	default y

endif
```
